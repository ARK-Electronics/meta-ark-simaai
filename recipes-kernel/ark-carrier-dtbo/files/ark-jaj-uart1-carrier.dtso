// SPDX-License-Identifier: (GPL-2.0+ OR MIT)
/*
 * ARK Just a Jetson — route Modalix SoM UART1 to the carrier gold finger.
 *
 * OPTIONAL / EXPERIMENTAL. Stack this *after* ark-jaj.dtbo:
 *
 *     setenv dtbos "ark-jaj.dtbo ark-jaj-uart1-carrier.dtbo"
 *
 * Why this exists
 * ---------------
 * SiMa's stock modalix-som.dts hogs SIO1_IO[2] (port1 line 2 — the GPIO bank of
 * the *same* SIO block that hosts uart12/UART1) output-high, named "usb_uart12":
 *
 *     &port1 {
 *             usb-hog {
 *                     gpio-hog;
 *                     gpios = <2 GPIO_ACTIVE_HIGH>;
 *                     output-high;
 *                     line-name = "usb_uart12";
 *             };
 *     };
 *
 * The SoM bring-up guide (005-HW-31 §1.6.2) says UART1 defaults to an on-module
 * UART-to-USB bridge, and that only "some carrier boards have UART1 available on
 * the 40-pin header". That line is the leading suspect for UART1 TX never
 * appearing on the JAJ gold finger (SODIMM 203/205 → J6): the SoC transmits, but
 * the module keeps UART1 pointed at the USB bridge.
 *
 * gpiolib checks hog state in the order input → output-low → output-high
 * (of_parse_own_gpio() in drivers/gpio/gpiolib-of.c), so adding output-low here
 * wins over the base DT's output-high. A runtime overlay cannot delete a
 * property, which is why this overrides rather than removes.
 *
 * Before deploying this, confirm the theory in seconds with no rebuild:
 *     ./scripts/uart1-tx-probe.sh mux carrier   # while scoping + spamming TX
 *
 * CAVEAT: stock images put the Linux console on UART1 (console=ttyS0). If this
 * line really is the mux, applying this overlay moves the console off the USB
 * bridge. Keep Ethernet/SSH or a UART0 console (ttyS1) available before you
 * reboot with it.
 */

/dts-v1/;
/plugin/;

&port1 {
	usb-hog {
		output-low;
	};
};
