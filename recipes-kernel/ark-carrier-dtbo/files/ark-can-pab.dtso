/dts-v1/;
/plugin/;

/*
 * Placeholder overlay: ARK Jetson CAN PAB
 *
 * Applied at runtime via U-Boot:
 *   setenv dtbos ark-can-pab.dtbo ; saveenv ; boot
 *
 * Replace fragments with real pinmux / CSI / I2C / PCIe / GPIO nodes
 * during hardware bring-up. Compatible string should match the base DTB.
 */

/ {
	compatible = "simaai,modalix";

	fragment@0 {
		target-path = "/";
		__overlay__ {
			ark_can_pab {
				compatible = "ark,jetson-can-pab";
				status = "okay";
				/* TODO: carrier peripherals (INA238, IMU, CAN, CSI, ...) */
			};
		};
	};
};
